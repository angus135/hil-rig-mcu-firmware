/******************************************************************************
 *  File:       hw_spi_rx.c
 *  Author:     Angus Corr
 *  Created:    10-Apr-2026
 *
 *  Description:
 *      RX-side implementation for the low-level SPI driver used by the HIL-RIG
 *      firmware.
 *
 *      This file contains the RX DMA start helper, RX DMA IRQ entry points, and
 *      public RX peek/consume functions. Shared state and common helpers are
 *      declared through hw_spi.h when HW_SPI_INTERNAL is enabled.
 *  Notes:
 *      Runtime TX/RX paths intentionally keep validation minimal. Configuration
 *      functions perform setup-time checks; ISR and hot-path functions assume
 *      the selected peripheral has already been configured correctly.
 ******************************************************************************/

/**-----------------------------------------------------------------------------
 *  Includes
 *------------------------------------------------------------------------------
 */

#define HW_SPI_INTERNAL
#include "hw_spi.h"

/**-----------------------------------------------------------------------------
 *  Defines / Macros
 *------------------------------------------------------------------------------
 */

/**-----------------------------------------------------------------------------
 *  Typedefs / Enums / Structures
 *------------------------------------------------------------------------------
 */

/**-----------------------------------------------------------------------------
 *  Public (global) and Extern Variables
 *------------------------------------------------------------------------------
 */

/**-----------------------------------------------------------------------------
 *  Private (static) Variables
 *------------------------------------------------------------------------------
 */

/**-----------------------------------------------------------------------------
 *  Private (static) Function Prototypes
 *------------------------------------------------------------------------------
 */

/**-----------------------------------------------------------------------------
 *  Private Function Definitions
 *------------------------------------------------------------------------------
 */

/**
 * @brief Arm RX DMA without causing master-mode dummy clock generation.
 *
 * PASSIVE RX DMA CHANGE:
 * HAL_SPI_Receive_DMA() is not suitable for this driver model when the SPI
 * peripheral is configured as a 2-line master. STM32 HAL implements that case
 * as a transmit/receive operation so the master can generate SCK, which can
 * clock a full RX buffer worth of dummy traffic.
 *
 * This helper arms RX DMA directly. It lets RX DMA drain SPI->DR whenever
 * frames arrive, but it does not generate clocks by itself. Clocks are only
 * generated by explicit TX activity.
 */
bool HW_SPI_RX_Start_Passive_DMA( SPIPeripheralState_T* peripheral_state )
{
    uint16_t rx_length_elements = 0U;

    if ( peripheral_state == NULL )
    {
        return false;
    }

    if ( peripheral_state->rx_dma == NULL )
    {
        return false;
    }

    // The software buffer size is in bytes, but the DMA NDTR length is in DMA
    // elements. In 8-bit mode bytes == elements; in 16-bit mode two bytes are
    // one DMA element.
    rx_length_elements = HW_SPI_Bytes_To_DMA_Elements( peripheral_state, RX_BUFFER_SIZE_BYTES );

    // Reset the software consume index. The DMA write index is calculated later
    // from NDTR in HW_SPI_Rx_Peek().
    peripheral_state->rx_position = 0U;

    // Reprogram the RX stream from a known disabled state. The stream is
    // circular, so once enabled it continuously drains SPI->DR into rx_buffer.
    LL_DMA_DisableStream( peripheral_state->rx_dma, peripheral_state->rx_dma_stream );
    while ( LL_DMA_IsEnabledStream( peripheral_state->rx_dma, peripheral_state->rx_dma_stream )
            != 0U )
    {
    }

    // Memory address is the start of the circular RX buffer. The stream itself
    // wraps in hardware when it reaches the programmed length.
    LL_DMA_SetMemoryAddress( peripheral_state->rx_dma, peripheral_state->rx_dma_stream,
                             ( uintptr_t )peripheral_state->rx_buffer );

    // Peripheral address is the SPI data register. RX DMA copies from SPI->DR
    // into rx_buffer whenever the SPI peripheral receives a frame.
    LL_DMA_SetPeriphAddress( peripheral_state->rx_dma, peripheral_state->rx_dma_stream,
                             LL_SPI_DMA_GetRegAddr( peripheral_state->spi_peripheral ) );

    // Program the full circular buffer length. LL_DMA_GetDataLength() later
    // exposes the remaining element count, which HW_SPI_Rx_Peek() converts back
    // into a software write index.
    LL_DMA_SetDataLength( peripheral_state->rx_dma, peripheral_state->rx_dma_stream,
                          rx_length_elements );

    // Enable the DMA stream before enabling the SPI RX DMA request so that an
    // incoming byte cannot set RXNE without somewhere to be drained.
    LL_DMA_EnableStream( peripheral_state->rx_dma, peripheral_state->rx_dma_stream );
    LL_SPI_EnableDMAReq_RX( peripheral_state->spi_peripheral );

    // Enabling SPI here arms the peripheral. For a master, this does not clock
    // anything by itself; clocks are generated only by explicit TX activity.
    LL_SPI_Enable( peripheral_state->spi_peripheral );

    return true;
}

/**-----------------------------------------------------------------------------
 *  Public Function Definitions
 *------------------------------------------------------------------------------
 */

/**
 * @brief RX DMA IRQ entry point for SPI channel 0.
 *
 * @details
 *     RX DMA is configured as a circular passive stream. No transfer-complete
 *     handling is currently required because the software read position is
 *     calculated from NDTR when HW_SPI_Rx_Peek() is called.
 */
void SPI_CHANNEL_0_RX_DMA_IRQ( void )
{
    // Circular RX DMA does not require per-interrupt work in the current design.
}

/**
 * @brief RX DMA IRQ entry point for SPI channel 1.
 *
 * @details
 *     RX DMA is configured as a circular passive stream. No transfer-complete
 *     handling is currently required because the software read position is
 *     calculated from NDTR when HW_SPI_Rx_Peek() is called.
 */
void SPI_CHANNEL_1_RX_DMA_IRQ( void )
{
    // Circular RX DMA does not require per-interrupt work in the current design.
}

/**
 * @brief Start the runtime RX side of a configured SPI channel.
 *
 * @details
 *     This function arms passive RX DMA for channels that support reception. It
 *     deliberately does not start TX activity and does not generate master-mode
 *     clocks. TX activity is started separately by loading data and kicking the
 *     TX engine.
 *
 * @param peripheral
 *     Logical SPI peripheral to start.
 */
void HW_SPI_Start_Channel( SPIPeripheral_T peripheral )
{
    SPIPeripheralState_T* peripheral_state = NULL;

    // Start only the RX side here. TX is deliberately separate and is started by
    // HW_SPI_Load_Tx_Buffer() plus HW_SPI_Tx_Trigger().
    switch ( peripheral )
    {
        case SPI_CHANNEL_0:
            peripheral_state = channel_0_state;
            break;

        case SPI_CHANNEL_1:
            peripheral_state = channel_1_state;
            break;

        case SPI_DAC:  // SPI will not be receiving anything
        default:
            return;
    }

    // Arm RX DMA directly instead of using HAL_SPI_Receive_DMA(). This keeps
    // master-mode RX passive: no clocks are generated until the caller starts a
    // TX transfer.
    ( void )HW_SPI_RX_Start_Passive_DMA( peripheral_state );
}

/**
 * @brief Return unread RX data as one or two spans into the DMA buffer.
 *
 * @details
 *     The RX DMA stream writes circularly into rx_buffer. This function converts
 *     the DMA NDTR element count into a byte write index and returns a stable
 *     view of unread data without copying or consuming it.
 *
 * @param peripheral
 *     Logical SPI peripheral whose RX stream should be inspected.
 *
 * @return
 *     Up to two read-only spans that cover the unread region.
 */
HWSPIRxSpans_T HW_SPI_Rx_Peek( SPIPeripheral_T peripheral )
{
    SPIPeripheralState_T* peripheral_state       = NULL;
    uint8_t*              rx_buffer              = NULL;
    uint32_t              read_index             = 0U;
    uint32_t              dma_remaining_elements = 0U;
    uint32_t              dma_remaining_bytes    = 0U;
    uint32_t              dma_write_index        = 0U;
    uint32_t              unread_bytes           = 0U;

    switch ( peripheral )
    {
        case SPI_CHANNEL_0:
            peripheral_state = channel_0_state;
            rx_buffer        = channel_0_state->rx_buffer;
            read_index       = channel_0_state->rx_position;
            dma_remaining_elements =
                LL_DMA_GetDataLength( SPI_CHANNEL_0_RX_DMA, SPI_CHANNEL_0_RX_DMA_STREAM );
            break;

        case SPI_CHANNEL_1:
            peripheral_state = channel_1_state;
            rx_buffer        = channel_1_state->rx_buffer;
            read_index       = channel_1_state->rx_position;
            dma_remaining_elements =
                LL_DMA_GetDataLength( SPI_CHANNEL_1_RX_DMA, SPI_CHANNEL_1_RX_DMA_STREAM );
            break;

        case SPI_DAC:
        default:
            return ( HWSPIRxSpans_T ){ .first_span         = { .data = NULL, .length_bytes = 0U },
                                       .second_span        = { .data = NULL, .length_bytes = 0U },
                                       .total_length_bytes = 0U };
    }

    // DMA NDTR is expressed in DMA elements, not bytes. Convert back to bytes
    // so the software RX stream remains byte-oriented.
    dma_remaining_bytes = HW_SPI_DMA_Elements_To_Bytes( peripheral_state, dma_remaining_elements );

    // In circular RX mode, NDTR counts down from the full buffer length to 0
    // and then reloads. Subtracting the remaining count gives the current DMA
    // write index in byte units.
    dma_write_index = RX_BUFFER_SIZE_BYTES - dma_remaining_bytes;

    if ( dma_write_index == RX_BUFFER_SIZE_BYTES )
    {
        dma_write_index = 0U;
    }

    // The modulo subtraction handles both non-wrapped and wrapped unread RX
    // regions.
    unread_bytes = ( dma_write_index + RX_BUFFER_SIZE_BYTES - read_index ) % RX_BUFFER_SIZE_BYTES;

    if ( unread_bytes == 0U )
    {
        return ( HWSPIRxSpans_T ){ .first_span  = { .data = &rx_buffer[0], .length_bytes = 0U },
                                   .second_span = { .data = &rx_buffer[0], .length_bytes = 0U },
                                   .total_length_bytes = 0U };
    }

    // If the DMA write index is ahead of the software read index, all unread
    // data is one contiguous span.
    if ( dma_write_index > read_index )
    {
        return ( HWSPIRxSpans_T ){
            .first_span         = { .data = &rx_buffer[read_index], .length_bytes = unread_bytes },
            .second_span        = { .data = &rx_buffer[0], .length_bytes = 0U },
            .total_length_bytes = unread_bytes };
    }

    // Otherwise the unread data wraps around the end of rx_buffer. Return two
    // spans so the caller can process both without copying inside the driver.
    uint32_t first_span_length  = RX_BUFFER_SIZE_BYTES - read_index;
    uint32_t second_span_length = unread_bytes - first_span_length;

    return ( HWSPIRxSpans_T ){
        .first_span         = { .data = &rx_buffer[read_index], .length_bytes = first_span_length },
        .second_span        = { .data = &rx_buffer[0], .length_bytes = second_span_length },
        .total_length_bytes = unread_bytes };
}

/**
 * @brief Mark previously received RX bytes as consumed.
 *
 * Advances the internal unread-data consume position for the selected channel
 * by the specified number of bytes.
 *
 * This function provides the "consume" stage of the RX peek/consume model. It
 * is intended to be called after higher-level software has inspected or parsed
 * data returned by HW_SPI_Rx_Peek() and determined that some number of unread
 * bytes can be discarded from the unread region.
 *
 * This function only updates the driver's software consume position. It does
 * not copy data and does not modify the DMA hardware write position.
 *
 * This function does not impose message boundaries or protocol semantics. It
 * only advances the low-level driver's view of which RX bytes remain unread.
 *
 * If @p bytes_to_consume exceeds the actual unread byte count, behaviour is
 * implementation-defined unless explicitly guarded by higher-level software.
 *
 * @param peripheral
 *     The SPI peripheral/channel whose unread RX data should be advanced.
 *
 * @param bytes_to_consume
 *     The number of unread RX bytes to mark as consumed.
 */
void HW_SPI_Rx_Consume( SPIPeripheral_T peripheral, uint32_t bytes_to_consume )
{
    SPIPeripheralState_T* peripheral_state = HW_SPI_Get_State( peripheral );

    // Advance only the software consume index. The DMA write index is hardware
    // controlled and is derived from NDTR when peeking.
    peripheral_state->rx_position =
        ( peripheral_state->rx_position + bytes_to_consume ) % RX_BUFFER_SIZE_BYTES;
}
